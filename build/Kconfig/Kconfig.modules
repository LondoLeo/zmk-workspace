## build/Kconfig/Kconfig.modules
```kconfig
menu "zmk-adaptive-key (/Users/marcus/Development/zmk-workspace/modules/zmk/adaptive-key)"
osource "/Users/marcus/Development/zmk-workspace/modules/zmk/adaptive-key/Kconfig"
config ZEPHYR_ZMK_ADAPTIVE_KEY_MODULE
	bool
	default y
endmenu
menu "zmk-auto-layer (/Users/marcus/Development/zmk-workspace/modules/zmk/auto-layer)"
osource "/Users/marcus/Development/zmk-workspace/modules/zmk/auto-layer/Kconfig"
config ZEPHYR_ZMK_AUTO_LAYER_MODULE
	bool
	default y
endmenu
menu "zmk-leader-key (/Users/marcus/Development/zmk-workspace/modules/zmk/leader-key)"
osource "/Users/marcus/Development/zmk-workspace/modules/zmk/leader-key/Kconfig"
config ZEPHYR_ZMK_LEADER_KEY_MODULE
	bool
	default y
endmenu
menu "tri-state (/Users/marcus/Development/zmk-workspace/modules/zmk/tri-state)"
osource "/Users/marcus/Development/zmk-workspace/modules/zmk/tri-state/Kconfig"
config ZEPHYR_TRI_STATE_MODULE
	bool
	default y
endmenu
menu "zmk-unicode (/Users/marcus/Development/zmk-workspace/modules/zmk/unicode)"
osource "/Users/marcus/Development/zmk-workspace/modules/zmk/unicode/Kconfig"
config ZEPHYR_ZMK_UNICODE_MODULE
	bool
	default y
endmenu
menu "nanopb (/Users/marcus/Development/zmk-workspace/modules/lib/nanopb)"
osource "$(ZEPHYR_NANOPB_KCONFIG)"
config ZEPHYR_NANOPB_MODULE
	bool
	default y
endmenu
menu "cmsis (/Users/marcus/Development/zmk-workspace/modules/hal/cmsis)"
osource "$(ZEPHYR_CMSIS_KCONFIG)"
config ZEPHYR_CMSIS_MODULE
	bool
	default y
endmenu
menu "hal_nordic (/Users/marcus/Development/zmk-workspace/modules/hal/nordic)"
osource "$(ZEPHYR_HAL_NORDIC_KCONFIG)"
config ZEPHYR_HAL_NORDIC_MODULE
	bool
	default y
endmenu
menu "hal_rpi_pico (/Users/marcus/Development/zmk-workspace/modules/hal/rpi_pico)"
osource "$(ZEPHYR_HAL_RPI_PICO_KCONFIG)"
config ZEPHYR_HAL_RPI_PICO_MODULE
	bool
	default y
endmenu
menu "lvgl (/Users/marcus/Development/zmk-workspace/modules/lib/gui/lvgl)"
osource "/Users/marcus/Development/zmk-workspace/modules/lib/gui/lvgl/Kconfig"
config ZEPHYR_LVGL_MODULE
	bool
	default y
endmenu
menu "module (/Users/marcus/Development/zmk-workspace/zmk/app/module)"
osource "/Users/marcus/Development/zmk-workspace/zmk/app/module/Kconfig"
config ZEPHYR_MODULE_MODULE
	bool
	default y
endmenu
```

## build/Kconfig/Kconfig.shield
```kconfig
osource "/Users/marcus/Sync/splaytoraid-zmk/boards/shields/*/Kconfig.shield"
osource "/Users/marcus/Development/zmk-workspace/zmk/app/boards/shields/*/Kconfig.shield"
```

## build/Kconfig/Kconfig.shield.defconfig
```kconfig
osource "/Users/marcus/Sync/splaytoraid-zmk/boards/shields/*/Kconfig.defconfig"
osource "/Users/marcus/Development/zmk-workspace/zmk/app/boards/shields/*/Kconfig.defconfig"
```
